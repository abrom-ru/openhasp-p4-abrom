## components/boards/wireless_tag/wt32_sc01_plus/sdkconfig.defaults.board
```kconfig
# ============================================================
# PSRAM Hardware
# ============================================================

CONFIG_SPIRAM=y
CONFIG_SPIRAM_MODE_QUAD=y
CONFIG_SPIRAM_TYPE_AUTO=y

CONFIG_SPIRAM_SPEED_80M=y
CONFIG_SPIRAM_SPEED=80
```

## esp/partitions/sdkconfig.defaults.16mb
```kconfig
CONFIG_ESPTOOLPY_FLASHSIZE_16MB=y
CONFIG_PARTITION_TABLE_CUSTOM=y
CONFIG_PARTITION_TABLE_CUSTOM_FILENAME="esp/partitions/partitions.16mb.csv"
```

## esp/partitions/sdkconfig.defaults.8mb
```kconfig
CONFIG_ESPTOOLPY_FLASHSIZE_8MB=y
CONFIG_PARTITION_TABLE_CUSTOM=y
CONFIG_PARTITION_TABLE_CUSTOM_FILENAME="esp/partitions/partitions.8mb.csv"
```

## esp/sdkconfig.defaults.esp32
```kconfig
# ============================================================
# ESP32
# ============================================================

CONFIG_LV_DRAW_SW_DRAW_UNIT_CNT=2   
```

## esp/sdkconfig.defaults.esp32s2
```kconfig
# ============================================================
# ESP32-S2
# ============================================================

CONFIG_LV_DRAW_SW_DRAW_UNIT_CNT=1

# CONFIG_SPIRAM_XIP_FROM_PSRAM=y
```

## esp/sdkconfig.defaults.esp32s3
```kconfig
# ============================================================
# ESP32-S3 common defaults
# ============================================================

CONFIG_ESP32S3_DEFAULT_CPU_FREQ_240=y
CONFIG_ESP32S3_DATA_CACHE_64KB=y
CONFIG_ESP32S3_INSTRUCTION_CACHE_32KB=y
CONFIG_ESP32S3_DATA_CACHE_LINE_64B=y

CONFIG_ESPTOOLPY_FLASHMODE_QIO=y

# ============================================================
# WIFI CONFIG
# ============================================================

# Use native WiFi : Disable Remote WiFi
CONFIG_ESP_WIFI_REMOTE_ENABLED=n

# Fix for: wifi:[ADDBA]RX DELBA, reason:39, delete tid:0, initiator:0(recipient)
CONFIG_WIFI_RMT_AMPDU_TX_ENABLED=n
CONFIG_WIFI_RMT_AMPDU_RX_ENABLED=n
CONFIG_ESP_WIFI_AMPDU_RX_ENABLED=n
CONFIG_ESP_WIFI_AMPDU_TX_ENABLED=n

# ============================================================
# LVGL CONFIG
# ============================================================

# LVGL software rendering
CONFIG_LV_DRAW_SW_DRAW_UNIT_CNT=2

# ============================================================
# PSRAM Runtime Policies
# ============================================================

CONFIG_SPIRAM_USE_MALLOC=y
CONFIG_SPIRAM_MALLOC_ALWAYSINTERNAL=16384
CONFIG_SPIRAM_MALLOC_RESERVE_INTERNAL=32768
CONFIG_SPIRAM_ALLOW_STACK_EXTERNAL_RAM=y
CONFIG_SPIRAM_XIP_FROM_PSRAM=y

CONFIG_SPIRAM_BOOT_HW_INIT=y
CONFIG_SPIRAM_BOOT_INIT=y
CONFIG_SPIRAM_PRE_CONFIGURE_MEMORY_PROTECTION=y
```

## main/Kconfig.projbuild
```kconfig
menu "Board LVGL adapter integration"

config BOARD_LVGL_USE_DSI
    bool "Enable MIPI DSI display path"
    default n
    help
        Compile the MIPI DSI branch in board_lvgl.c. Required for boards
        whose display_lcd device declares sub_type: dsi.

config BOARD_LVGL_USE_RGB
    bool "Enable RGB display path"
    default n
    help
        Compile the parallel RGB branch in board_lvgl.c. Required for boards
        whose display_lcd device declares sub_type: rgb.

config BOARD_LVGL_USE_RGB_3WIRE_SPI
    bool "Enable RGB + 3-wire SPI display path"
    default n
    help
        Compile the RGB-over-3-wire-SPI branch in board_lvgl.c. Required for
        boards whose display_lcd device declares sub_type: rgb_3wire_spi.

endmenu
```
